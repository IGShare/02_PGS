/*
 * LedController.cpp
 *
 * Created: 2017-04-25 오후 5:44:49
 * Author : myeom
 */ 

#include <avr/io.h>
#include <avr/interrupt.h>

/*****************************************************
Project : 16X16 도트매트릭스 확장보드(LK-DOTM16)(ATmega128용)
Version :
Date    : 2013-07-06
Author  : Kyung Nam Lee
Company : LK임베디드
Comments: 가~하, A~Z까지의 문자를 출력하는 프로그램이다.
Chip type               : ATmega128
Program type            : Application
AVR Core Clock frequency: 16.000000 MHz
Memory model            : Small
External RAM size       : 0
Data Stack size         : 1024
*****************************************************/


#include <util/delay.h>
#define A0  PD0
#define A1  PD1
#define A2  PD2
#define A3  PD3
#define Data_Red PD4
#define Data_Green PD5
#define Clk  PD6
#define LE PD7
#define OE PB0
unsigned int string[][16]={
	0x00,0x1800,0x18fe,0x1980,0x1980,0x1980,0x7980,0x1980,0x18c0,0x18c0,0x1860,0x1838,0x180e,0x1800,0x00,0x00, //가
	0x00,0x1800,0x1806,0x1806,0x1806,0x1806,0x7806,0x1806,0x1806,0x1806,0x1806,0x1806,0x1bfc,0x1800,0x00,0x00, //나
	0x00,0x1800,0x19fc,0x1806,0x1806,0x1806,0x7806,0x1806,0x1806,0x1806,0x1806,0x1806,0x1bfc,0x1800,0x00,0x00, //다
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	0x00,0x00,0xff0,0xc00,0x600,0x300,0x300,0x180,0xc0,0xc0,0x60,0x30,0xff0,0x00,0x00,0x00, //Z
};
// Timer 0 overflow interrupt service routine
unsigned char flag_cnt=0;
#include <stdio.h>
volatile unsigned int Move_cnt=15;
volatile unsigned int Move_cnt2=0;
unsigned char key_input=0;
volatile unsigned int up_cnt=0;
#define string_stop_time_value 2000
#define string_moving_speed_value 50

#define up_down 1
#define left_right 2

static unsigned int str_speed_cnt=0;

unsigned char move_motion=0;

uint8_t toggle_char=0;
uint8_t toggle_flag=0;
#define in1 0
#define in2 1  //현재 모션은 도트매트릭스 1과 도트매트릭스 2과 겹친다.
#define in3 2
#define in4 3
#define in5 4
#define in6 5
#define in7 6
static unsigned int Dot_char_cnt=0; //도트매트릭스에 표시 될 문자 카운팅!
//Timer 0 overflow interrupt service routine
//interrupt [TIM0_OVF] void timer0_ovf_isr(void)
ISR(TIMER0_OVF_vect)
{
	static unsigned int toggle_cnt=0;
	static unsigned int cnt=0;
	cnt++;
	if(cnt==500)
	{
		cnt=0;
	}
	if(toggle_char){
		toggle_cnt++;
		if(toggle_cnt>1000)
		{
			toggle_char=0;
			toggle_cnt=0;
			toggle_flag^=1;
			move_motion=0;
			
		}
	}
	key_input=PINC&0x0f;
	str_speed_cnt++;
	if(str_speed_cnt>string_moving_speed_value) //문자가 500초 머문 후 시프트 시작!
	{
		
		str_speed_cnt=0; //string moving speed counter
		Move_cnt--;
		Move_cnt2++;
		up_cnt++; //문자 위아래 이동 속도 카운트
		if(Move_cnt==0||Move_cnt2==15)
		{
			Move_cnt2=0;
			Move_cnt=15;
			move_motion++; //문자 진입 상태 버퍼
			if(move_motion==2)
			{
				move_motion=0;
				Dot_char_cnt++;
				flag_cnt++;
				if(flag_cnt==3)
				{
					flag_cnt=0;
				}
			}
		}

	}
	TCNT0|=0x06;
}
void row_dynamic()
{
	static unsigned int str_cnt=0;

	switch(str_cnt)//ROW SHIFT!
	{
		case 0:PORTD &= ~(1<<A0);PORTD &= ~(1<<A1);PORTD &= ~(1<<A2);PORTD &= ~(1<<A3);break;//case 0:A0=0; A1=0; A2=0; A3=0;break;
		case 1:PORTD |= (1<<A0); PORTD &= ~(1<<A1);PORTD &= ~(1<<A2);PORTD &= ~(1<<A3);break;//case 1:A0=1; A1=0; A2=0; A3=0; break;
		case 2:PORTD &= ~(1<<A0);PORTD |= (1<<A1); PORTD &= ~(1<<A2);PORTD &= ~(1<<A3);break;//case 2:A0=0; A1=1; A2=0; A3=0; break;
		case 3:PORTD |= (1<<A0); PORTD |= (1<<A1); PORTD &= ~(1<<A2);PORTD &= ~(1<<A3);break;//case 3:A0=1; A1=1; A2=0; A3=0; break;
		case 4:PORTD &= ~(1<<A0);PORTD &= ~(1<<A1);PORTD |=  (1<<A2);PORTD &= ~(1<<A3);break;//case 4:A0=0; A1=0; A2=1; A3=0; break;
		case 5:PORTD |=  (1<<A0);PORTD &= ~(1<<A1);PORTD |=  (1<<A2);PORTD &= ~(1<<A3);break;//case 5:A0=1; A1=0; A2=1; A3=0; break;
		case 6:PORTD &= ~(1<<A0);PORTD |=  (1<<A1);PORTD |=  (1<<A2);PORTD &= ~(1<<A3);break;//case 6:A0=0; A1=1; A2=1; A3=0; break;
		case 7:PORTD |=  (1<<A0);PORTD |=  (1<<A1);PORTD |=  (1<<A2);PORTD &= ~(1<<A3);break;//case 7:A0=1; A1=1; A2=1; A3=0; break;
		case 8:PORTD &= ~(1<<A0);PORTD &= ~(1<<A1);PORTD &= ~(1<<A2);PORTD |=  (1<<A3);break;//case 8:A0=0; A1=0; A2=0; A3=1; break;
		case 9:PORTD |=  (1<<A0);PORTD &= ~(1<<A1);PORTD &= ~(1<<A2);PORTD |=  (1<<A3);break;//case 9:A0=1; A1=0; A2=0; A3=1; break;
		case 10:PORTD &= ~(1<<A0);PORTD |=  (1<<A1);PORTD &= ~(1<<A2);PORTD |=  (1<<A3);break;//case 10:A0=0; A1=1; A2=0; A3=1; break;
		case 11:PORTD |=  (1<<A0);PORTD |=  (1<<A1);PORTD &= ~(1<<A2);PORTD |=  (1<<A3);break;//case 11:A0=1; A1=1; A2=0; A3=1; break;
		case 12:PORTD &= ~(1<<A0);PORTD &= ~(1<<A1);PORTD |=  (1<<A2);PORTD |=  (1<<A3);break;//case 12:A0=0; A1=0; A2=1; A3=1; break;
		case 13:PORTD |= ~(1<<A0);PORTD &= ~(1<<A1);PORTD |=  (1<<A2);PORTD |=  (1<<A3);break;//case 13:A0=1; A1=0; A2=1; A3=1; break;
		case 14:PORTD &= ~(1<<A0);PORTD |=  (1<<A1);PORTD |=  (1<<A2);PORTD |=  (1<<A3);break;//case 14:A0=0; A1=1; A2=1; A3=1; break;
		case 15:PORTD |=  (1<<A0);PORTD |=  (1<<A1);PORTD |=  (1<<A2);PORTD |=  (1<<A3);break;//case 15:A0=1; A1=1; A2=1; A3=1; break;
	}
	
	++str_cnt;
	if(str_cnt==16)
	{
		str_cnt=0;
	}
}
void shift_Driver(unsigned char out)
{

	unsigned char clk=0;
	for(clk=0;clk<8;clk++){ //8비트 데이터를 1비트씩 시프트레지스터에 입력
		if(out&(0x80>>clk))
		{
			switch(flag_cnt) { // LED 색상 선택!
				case 0:PORTD &= ~(1<<Data_Green);PORTD |=  (1<<Data_Red); break;//case 0:Data_Green=0;Data_Red=1; break;
				case 1:PORTD |=  (1<<Data_Green);PORTD &= ~(1<<Data_Red); break;//case 1:Data_Green=1;Data_Red=0; break;
				case 2:PORTD &= ~(1<<Data_Green);PORTD &= ~(1<<Data_Red); break;//case 2:Data_Green=1;Data_Red=1; break;
			}
		}
		else {
			PORTD &= ~(1<<Data_Green);//Data_Green=0;
			PORTD &= ~(1<<Data_Red);//Data_Red=0;
		}
		//PORTD |=  (1<<Data_Green);PORTD &= ~(1<<Data_Red);
		PORTD |= (1<<Clk);_delay_us(1);PORTD &= ~(1<<Clk);//Clk=1;_delay_us(1);Clk=0;
	}
}

void ActivePulse()
{
	PORTD |= (1<<LE); _delay_us(1); PORTD &= ~(1<<LE);//LE=1; _delay_us(1); LE=0;// 래치 출력
	PORTB &= ~(1<<OE);//OE=0;
	_delay_us(500); // OUTPUT ENABLE
}

void dot1_display_shift(unsigned int first)
{
	static unsigned int i_cnt=0;
	register unsigned int buff[32]={0};
	register unsigned char high=0;
	register unsigned char low=0;
	register unsigned int i=0;
	for(i_cnt=0;i_cnt<32;i_cnt++){ //문자가 오른쪽에서 중앙으로, 중앙에서  왼쪽으로 흘러감을 표현
		//if(move_motion==in1)
		//{
			//buff[i_cnt]=string[first][i_cnt]<<Move_cnt; // 1st String Dot1 in
		//}
		//if(move_motion==in2)
		//{
			//
			//buff[i_cnt]=string[first][i_cnt]>>Move_cnt2; // 1st String Dot1 Out
		//}
		
		buff[i_cnt]=(uint16_t)(i_cnt | i_cnt << 8);//string[14][i_cnt];
	}
	for(i=0;i<32;i++)
	{
		high=(buff[i]>>8);
		low =(buff[i]&0xff);
		shift_Driver(low);
		shift_Driver(high);
		row_dynamic();
		ActivePulse();
	}
}
int main(void)
{
DDRD=0xff;
DDRB=0x01;
/*
 A0  PORTD.0
 A1  PORTD.1
 A2  PORTD.2
 A3  PORTD.3
 Data_Red PORTD.4
 Data_Green PORTD.5
 Clk  PORTD.6
 LE PORTD.7
 OE PORTB.0 
*/

//TCCR0=0x04;
//TCNT0=0x06;
//TIMSK=0x01;
// Global enable interrupts
sei();
toggle_char=0;
while(1)
{
 dot1_display_shift(Dot_char_cnt);    
 if(Dot_char_cnt==40)
 Dot_char_cnt=0;
}
}

